## external/br2-external/Config.in
```kconfig
source "$BR2_EXTERNAL_BR2EXT_PATH/reCamera/Config.in"
source "$BR2_EXTERNAL_BR2EXT_PATH/libhv/Config.in"
source "$BR2_EXTERNAL_BR2EXT_PATH/libxcrypt-dev/Config.in"
source "$BR2_EXTERNAL_BR2EXT_PATH/sscma-node/Config.in"
source "$BR2_EXTERNAL_BR2EXT_PATH/sscma-supervisor/Config.in"
source "$BR2_EXTERNAL_BR2EXT_PATH/opencv4/Config.in"
source "$BR2_EXTERNAL_BR2EXT_PATH/opencv4-contrib/Config.in"
source "$BR2_EXTERNAL_BR2EXT_PATH/bt-init/Config.in"
```

## external/br2-external/bt-init/Config.in
```kconfig
config BR2_PACKAGE_BT_INIT
    bool "bt-init"
    default y
    select BR2_PACKAGE_BLUEZ5_UTILS
    help
      This is the help text for the bt-init package.
      It will be displayed in the Buildroot configuration menu.
```

## external/br2-external/morse_cli/Config.in
```kconfig
config BR2_PACKAGE_MORSE_CLI
    bool "morse_cli"
    default y
    help
      This is the help text for the morse_cli package.
      It will be displayed in the Buildroot configuration menu.
```

## external/br2-external/sscma-node/Config.in
```kconfig
config BR2_PACKAGE_SSCMA_NODE
    bool "sscma-node"
    default y
    select BR2_PACKAGE_MOSQUITTO 
    select BR2_PACKAGE_LIBHV 
    select BR2_PACKAGE_ALSA_LIB
    select BR2_PACKAGE_ALSA_UTILS
    select BR2_PACKAGE_ALSA_UTILS_ALSAMIXER
    help
      This is the help text for the ssmca-node package.
      It will be displayed in the Buildroot configuration menu.
```

## external/br2-external/sscma-supervisor/Config.in
```kconfig
config BR2_PACKAGE_SSCMA_SUPERVISOR
    bool "sscma-supervisor"
    default y
    select BR2_PACKAGE_LIBHV
    help
      This is the help text for the ssmca-supervisor package.
      It will be displayed in the Buildroot configuration menu.
```

## external/br2-external/wpa_supplicant_s1g/Config.in
```kconfig
config BR2_PACKAGE_WPA_SUPPLICANT_S1G
    bool "wpa_supplicant_s1g"
    select BR2_PACKAGE_LIBNL
    select BR2_PACKAGE_OPENSSL
    default y
    help
      This is the help text for the wpa_supplicant_s1g package.
      It will be displayed in the Buildroot configuration menu.
```
